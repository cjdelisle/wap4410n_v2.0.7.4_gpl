## src/linux/kernels/mips-linux-2.6.15/net/bridge/Kconfig
```kconfig
#
# 802.1d Ethernet Bridging
#

config BRIDGE
	tristate "802.1d Ethernet Bridging"
	---help---
	  If you say Y here, then your Linux box will be able to act as an
	  Ethernet bridge, which means that the different Ethernet segments it
	  is connected to will appear as one Ethernet to the participants.
	  Several such bridges can work together to create even larger
	  networks of Ethernets using the IEEE 802.1 spanning tree algorithm.
	  As this is a standard, Linux bridges will cooperate properly with
	  other third party bridge products.

	  In order to use the Ethernet bridge, you'll need the bridge
	  configuration tools; see <file:Documentation/networking/bridge.txt>
	  for location. Please read the Bridge mini-HOWTO for more
	  information.

	  If you enable iptables support along with the bridge support then you
	  turn your bridge into a bridging IP firewall.
	  iptables will then see the IP packets being bridged, so you need to
	  take this into account when setting up your firewall rules.
	  Enabling arptables support when bridging will let arptables see
	  bridged ARP traffic in the arptables FORWARD chain.

	  To compile this code as a module, choose M here: the module
	  will be called bridge.

	  If unsure, say N.

config ATHR_ETHERNET_PORT_MAC_LIMIT
	bool "Atheros ethernet port mac limit"
	depends on BRIDGE
	---help---
	  This feature enables the atheros ethernet port mac limit feature
	  using which its possible to restrict the no of mac address that 
	  can be processed by a physical ethernet port along with port specific
	  ageing timers

config ATHR_MAX_PHY_PORTS
	int "Max no of physical ethernet ports"
	default "4"
	depends on ATHR_ETHERNET_PORT_MAC_LIMIT
	---help---
	  Maximum of physical ports in the ethernet adapter


config ATHR_IGMPV2_SNOOPING
	bool "Atheros enable igmp snooping  "
	depends on ATHR_ETHERNET_PORT_MAC_LIMIT
	default "y"
	---help---
	  Enable / disable IGMP Snooping
```
